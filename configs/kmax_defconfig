## configs/kmax_defconfig
```kconfig
BR2_aarch64=y
BR2_CCACHE=y
BR2_PACKAGE_HOST_LINUX_HEADERS_CUSTOM_4_4=y
BR2_ROOTFS_MERGED_USR=y
BR2_TARGET_GENERIC_PASSWD_SHA256=y
BR2_ROOTFS_DEVICE_CREATION_DYNAMIC_EUDEV=y
# BR2_ENABLE_LOCALE_PURGE is not set
BR2_ROOTFS_POST_IMAGE_SCRIPT="board/kaleao/post-image.sh"
BR2_LINUX_KERNEL=y
BR2_LINUX_KERNEL_CUSTOM_LOCAL=y
BR2_LINUX_KERNEL_CUSTOM_LOCAL_PATH="./kaleao/system/exynos7420_kernel_4.4"
BR2_LINUX_KERNEL_USE_CUSTOM_CONFIG=y
BR2_LINUX_KERNEL_CUSTOM_CONFIG_FILE="./kaleao/configs/kmax_defconfig"
BR2_LINUX_KERNEL_DTS_SUPPORT=y
BR2_LINUX_KERNEL_INTREE_DTS_NAME="exynos/kmax-reva-sdcard exynos/kmax-reva-ufs exynos/kmax-revb-sdcard exynos/kmax-revb-ufs"
BR2_PACKAGE_BUSYBOX_SHOW_OTHERS=y
BR2_PACKAGE_DOSFSTOOLS=y
BR2_PACKAGE_DOSFSTOOLS_FATLABEL=y
BR2_PACKAGE_DOSFSTOOLS_FSCK_FAT=y
BR2_PACKAGE_DOSFSTOOLS_MKFS_FAT=y
BR2_PACKAGE_E2FSPROGS=y
BR2_PACKAGE_MMC_UTILS=y
BR2_PACKAGE_DBUS=y
BR2_PACKAGE_PYTHON=y
BR2_PACKAGE_PYTHON_PY_ONLY=y
BR2_PACKAGE_PYTHON_READLINE=y
BR2_PACKAGE_PYTHON_SERIAL=y
BR2_PACKAGE_LIBCAP=y
BR2_PACKAGE_ETHTOOL=y
BR2_PACKAGE_IFTOP=y
BR2_PACKAGE_IPERF3=y
BR2_PACKAGE_IPTRAF_NG=y
BR2_PACKAGE_IPUTILS=y
BR2_PACKAGE_NETCAT=y
BR2_PACKAGE_NUTTCP=y
BR2_PACKAGE_OPENSSH=y
BR2_PACKAGE_TCPDUMP=y
BR2_PACKAGE_WGET=y
BR2_PACKAGE_COREUTILS=y
BR2_PACKAGE_HTOP=y
BR2_PACKAGE_IOTOP=y
BR2_PACKAGE_IRQBALANCE=y
BR2_PACKAGE_UTIL_LINUX_FSCK=y
BR2_PACKAGE_UTIL_LINUX_MOUNT=y
BR2_PACKAGE_KALEAO_KNET=y
BR2_TARGET_ROOTFS_CPIO=y
BR2_TARGET_ROOTFS_CPIO_GZIP=y
BR2_TARGET_ROOTFS_CPIO_UIMAGE=y
BR2_TARGET_ROOTFS_EXT2=y
BR2_TARGET_ROOTFS_EXT2_4=y
BR2_PACKAGE_HOST_DTC=y
BR2_PACKAGE_HOST_GENIMAGE=y
BR2_PACKAGE_HOST_UTIL_LINUX=y
```

## configs/kmax_noramfs_defconfig
```kconfig
BR2_aarch64=y
BR2_KERNEL_HEADERS_4_4=y
BR2_GLIBC_VERSION_2_24=y
BR2_BINUTILS_VERSION_2_27_X=y
BR2_GCC_VERSION_6_X=y
BR2_ROOTFS_MERGED_USR=y
BR2_TARGET_GENERIC_HOSTNAME="exynos"
BR2_TARGET_GENERIC_ISSUE="Welcome to KMAX"
BR2_TARGET_GENERIC_PASSWD_SHA256=y
# BR2_ENABLE_LOCALE_PURGE is not set
BR2_ROOTFS_OVERLAY="kaleao/system/rootfs_overlay"
BR2_PACKAGE_BUSYBOX_SHOW_OTHERS=y
BR2_PACKAGE_GDB=y
BR2_PACKAGE_GDB_SERVER=y
BR2_PACKAGE_GDB_DEBUGGER=y
BR2_PACKAGE_GDB_TUI=y
BR2_PACKAGE_GDB_PYTHON=y
BR2_PACKAGE_CPIO=y
BR2_PACKAGE_E2FSPROGS=y
BR2_PACKAGE_E2FSPROGS_RESIZE2FS=y
BR2_PACKAGE_MAKEDEVS=y
BR2_PACKAGE_DBUS=y
BR2_PACKAGE_IOSTAT=y
BR2_PACKAGE_PCIUTILS=y
BR2_PACKAGE_SYSSTAT=y
BR2_PACKAGE_PYTHON=y
BR2_PACKAGE_PYTHON_CURSES=y
BR2_PACKAGE_PYTHON_READLINE=y
BR2_PACKAGE_PYTHON_DAEMON=y
BR2_PACKAGE_PYTHON_HTTPLIB2=y
BR2_PACKAGE_PYTHON_IPADDR=y
BR2_PACKAGE_PYTHON_IPADDRESS=y
BR2_PACKAGE_PYTHON_LXML=y
BR2_PACKAGE_PYTHON_NETADDR=y
BR2_PACKAGE_PYTHON_NETIFACES=y
BR2_PACKAGE_PYTHON_PSUTIL=y
BR2_PACKAGE_PYTHON_PYCPARSER=y
BR2_PACKAGE_PYTHON_PYCRYPTO=y
BR2_PACKAGE_PYTHON_PYPCAP=y
BR2_PACKAGE_PYTHON_PYROUTE2=y
BR2_PACKAGE_PYTHON_PYSOCKS=y
BR2_PACKAGE_PYTHON_SERIAL=y
BR2_PACKAGE_PYTHON_SETUPTOOLS=y
BR2_PACKAGE_PYTHON_SMBUS_CFFI=y
BR2_PACKAGE_PYTHON_SOCKETIO=y
BR2_PACKAGE_LIBSYSFS=y
BR2_PACKAGE_LIBCAP=y
BR2_PACKAGE_NCURSES_TARGET_PANEL=y
BR2_PACKAGE_COLLECTD=y
BR2_PACKAGE_COLLECTD_CPUFREQ=y
BR2_PACKAGE_BRIDGE_UTILS=y
BR2_PACKAGE_ETHTOOL=y
BR2_PACKAGE_IFTOP=y
BR2_PACKAGE_IPERF3=y
BR2_PACKAGE_IPUTILS=y
BR2_PACKAGE_NETCAT=y
BR2_PACKAGE_NUTTCP=y
BR2_PACKAGE_OPENSSH=y
BR2_PACKAGE_TCPDUMP=y
BR2_PACKAGE_OPKG=y
BR2_PACKAGE_BASH=y
BR2_PACKAGE_FILE=y
BR2_PACKAGE_SUDO=y
BR2_PACKAGE_COREUTILS=y
BR2_PACKAGE_HTOP=y
BR2_PACKAGE_IRQBALANCE=y
BR2_PACKAGE_KMOD=y
BR2_PACKAGE_TAR=y
BR2_TARGET_ROOTFS_CPIO=y
BR2_TARGET_ROOTFS_CPIO_GZIP=y
BR2_TARGET_ROOTFS_CPIO_UIMAGE=y
BR2_TARGET_ROOTFS_EXT2=y
BR2_TARGET_ROOTFS_EXT2_4=y
BR2_TARGET_ROOTFS_TAR_GZIP=y
BR2_PACKAGE_HOST_DOS2UNIX=y
BR2_PACKAGE_HOST_DOSFSTOOLS=y
BR2_PACKAGE_HOST_DTC=y
BR2_PACKAGE_HOST_GENIMAGE=y
BR2_PACKAGE_HOST_UTIL_LINUX=y
```

## configs/zynq_zc706_defconfig
```kconfig
BR2_arm=y
BR2_cortex_a9=y
BR2_ARM_ENABLE_NEON=y
BR2_ARM_ENABLE_VFP=y
BR2_CCACHE=y
BR2_TOOLCHAIN_BUILDROOT_GLIBC=y
BR2_KERNEL_HEADERS_4_4=y
BR2_GLIBC_VERSION_2_24=y
BR2_BINUTILS_VERSION_2_27_X=y
BR2_TOOLCHAIN_BUILDROOT_CXX=y
BR2_GCC_ENABLE_LTO=y
BR2_ROOTFS_MERGED_USR=y
BR2_TARGET_GENERIC_PASSWD_SHA256=y
# BR2_TARGET_ENABLE_ROOT_LOGIN is not set
# BR2_TARGET_GENERIC_GETTY is not set
# BR2_ENABLE_LOCALE_PURGE is not set
BR2_LINUX_KERNEL=y
BR2_LINUX_KERNEL_CUSTOM_LOCAL=y
BR2_LINUX_KERNEL_CUSTOM_LOCAL_PATH="./kaleao/system/linux-4.4-kmax-npu"
BR2_LINUX_KERNEL_USE_CUSTOM_CONFIG=y
BR2_LINUX_KERNEL_CUSTOM_CONFIG_FILE="./kaleao/configs/kmax_defconfig"
BR2_LINUX_KERNEL_UIMAGE=y
BR2_LINUX_KERNEL_UIMAGE_LOADADDR="0x8000"
BR2_LINUX_KERNEL_DTS_SUPPORT=y
BR2_LINUX_KERNEL_INTREE_DTS_NAME="zynq-zc706"
BR2_PACKAGE_DBUS=y
BR2_PACKAGE_LIBSSH=y
BR2_PACKAGE_LIBCAP=y
BR2_PACKAGE_READLINE=y
BR2_PACKAGE_OPENSSH=y
BR2_PACKAGE_XINETD=y
BR2_PACKAGE_KMOD=y
BR2_PACKAGE_UTIL_LINUX=y
BR2_PACKAGE_UTIL_LINUX_BINARIES=y
BR2_PACKAGE_UTIL_LINUX_MOUNT=y
BR2_PACKAGE_UTIL_LINUX_NOLOGIN=y
BR2_PACKAGE_TESTING_INIT=y
BR2_PACKAGE_TEST=y
BR2_TARGET_ROOTFS_CPIO=y
BR2_TARGET_ROOTFS_CPIO_GZIP=y
BR2_TARGET_ROOTFS_CPIO_UIMAGE=y
BR2_TARGET_UBOOT=y
BR2_TARGET_UBOOT_BUILD_SYSTEM_KCONFIG=y
BR2_TARGET_UBOOT_CUSTOM_LOCAL=y
BR2_TARGET_UBOOT_CUSTOM_LOCAL_PATH="./kaleao/system/u-boot-kmax-npu"
BR2_TARGET_UBOOT_USE_CUSTOM_CONFIG=y
BR2_TARGET_UBOOT_CUSTOM_CONFIG_FILE="./kaleao/u-boot-kmax-netfpga/configs/zynq_kmax_defconfig"
BR2_TARGET_UBOOT_NEEDS_DTC=y
BR2_TARGET_UBOOT_NEEDS_OPENSSL=y
BR2_TARGET_UBOOT_FORMAT_IMG=y
BR2_TARGET_UBOOT_SPL=y
BR2_TARGET_UBOOT_SPL_NAME="spl/boot.bin"
```

## kaleao/system/exynos7420_kernel_4.4/Kaleao/Kconfig
```kconfig
menu "Kaleao KMAX"

config KMAX_LPC
bool "Shut down unused Exynos units on KMAX"
depends on ARCH_EXYNOS && ARM64
help
  On KMAX we only use the PCIE and the MMC blocks,
  all other blocks related to sound/video etc processing
  are just a waste of power. So by enabling this setting
  all unused units get shut down on bootup.

source "Kaleao/mach-exynos/Kconfig"

endmenu
```

## kaleao/system/exynos7420_kernel_4.4/Kaleao/mach-exynos/Kconfig
```kconfig
# arch/arm/mach-exynos/Kconfig
#
# Copyright (c) 2010-2011 Samsung Electronics Co., Ltd.
#		http://www.samsung.com/
#
# Licensed under GPLv2

# Configuration options for the EXYNOS4

if ARCH_EXYNOS

menu "Kaleao KMAX ASV"

config SOC_EXYNOS7420
	bool "Kmax EXYNOS7420"
	default n
	depends on ARCH_EXYNOS
	help
	  SOC exynos 7420 support

config EXYNOS_ASV
	bool "ENABLE EXYNOS ASV"
	default n
	depends on ARCH_EXYNOS

config EXYNOS_ASV_DYNAMIC_ABB
	bool "Enable Dynamic ABB"
	default n
	depends on EXYNOS_ASV

config EXYNOS_ASV_SUPPORT_RCC
	bool "Support RCC Table"
	default n
	depends on EXYNOS_ASV

config EXYNOS_ASV_MARGIN_TEST
	bool "Enable Margin Test"
	default n
	depends on EXYNOS_ASV


endmenu


endif
```

## package/kaleao-knet/Config.in
```kconfig
config BR2_PACKAGE_KALEAO_KNET
        bool "kaleao-knet"
        help
          Installation of Kmax 10Gbps multi-port driver for Exynos
```

## package/kaleao-ufs/Config.in
```kconfig
config BR2_PACKAGE_KALEAO_UFS
        bool "kaleao-ufs"
        help
          Installation of kaleao ufs files
```

## package/kaleao/Config.in
```kconfig
source "package/kaleao/exynos-agent/Config.in"
source "package/kaleao/kmax-appliance/Config.in"
```

## package/kaleao/exynos-agent/Config.in
```kconfig
config BR2_PACKAGE_KALEAO_EXYNOSAGENT
	bool "exynos-agent"
	help
	  The Baseboard Management Controller for Kaleao Exynos. 
```

## package/kaleao/kmax-appliance/Config.in
```kconfig
config BR2_PACKAGE_KMAX_APPLIANCE
	bool "kmax-appliance"
	help
	  The KMAX Appliance server system software.
```

## package/test/Config.in
```kconfig
config BR2_PACKAGE_TEST
        bool "test"
        help
          Installation of testing drivers
```
